/*
	Name:		HUB08_12x24_RGB.ino
	Created:	9/29/2017 8:19:44 PM
	Author:	Fox

	HUB08 pinouts P13.33-3S-1R1G1B-24X12
	GND		A
	GND		B
	GND		C
	OE		D
	RA1		G1
	B1		RB1
	GND		LAT
	GND		CLK
*/


#define PANEL_SIZE_X	24
#define PANEL_SIZE_Y	12
#define PANEL_SCAN_N	3

#define PIN_CLK		3
#define PIN_LATCH	4
#define PIN_OE		5
#define PIN_LINE_A	10
#define PIN_LINE_B	9
//#define PIN_LINE_C		N/C
//#define PIN_LINE_D		N/C
#define PIN_RED		8
#define PIN_GREEN	6
#define PIN_BLUE	7

unsigned long fps_delay = 1000;
unsigned long fps_last = 6;
unsigned long fps_start, fps_stop;
unsigned char fps_count = 0;

// Test pattern
uint16_t frame_buffer[] = {
	0xf800, 0xf800, 0xf800, 0xf800, 0xf800, 0xf800, 0xf800, 0xf800, 0xffff, 0xffff, 0xffff, 0xffff, 0xffff, 0xffff, 0xffff, 0xffff, 0xf800, 0xf800, 0x07e0, 0x07e0, 0x001f, 0x001f, 0xf800, 0xf800,
	0xf800, 0xf800, 0xf800, 0xf800, 0xf800, 0xf800, 0xf800, 0xf800, 0xffff, 0x0000, 0x0000, 0x0000, 0x0000, 0x0000, 0x0000, 0xffff, 0xf800, 0xf800, 0x07e0, 0x07e0, 0x001f, 0x001f, 0xf800, 0xf800,
	0xf800, 0xf800, 0xf800, 0xf800, 0xf800, 0xf800, 0xf800, 0xf800, 0xffff, 0x0000, 0x0000, 0x0000, 0x0000, 0x0000, 0x0000, 0xffff, 0x001f, 0x001f, 0xf800, 0xf800, 0x07e0, 0x07e0, 0x001f, 0x001f,
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	0x001f, 0x001f, 0x001f, 0x001f, 0x001f, 0x001f, 0x001f, 0x001f, 0xffff, 0xffff, 0xffff, 0xffff, 0xffff, 0xffff, 0xffff, 0xffff, 0x07e0, 0x07e0, 0x001f, 0x001f, 0xf800, 0xf800, 0x07e0, 0x07e0,
};

// the setup function runs once when you press reset or power the board
void setup() {
	Serial.begin(115200);


	pinMode(PIN_CLK, OUTPUT);
	pinMode(PIN_LATCH, OUTPUT);
	pinMode(PIN_OE, OUTPUT);
	pinMode(PIN_LINE_A, OUTPUT);
	pinMode(PIN_LINE_B, OUTPUT);
	pinMode(PIN_RED, OUTPUT);
	pinMode(PIN_GREEN, OUTPUT);
	pinMode(PIN_BLUE, OUTPUT);

	digitalWrite(PIN_RED, LOW);
	digitalWrite(PIN_GREEN, LOW);
	digitalWrite(PIN_BLUE, LOW);

	digitalWrite(PIN_OE, HIGH);
	digitalWrite(PIN_LATCH, LOW);
	digitalWrite(PIN_CLK, LOW);

	//analogWrite(PIN_OE, 2);	// Brightness, inverted: 255 is minimum!
}

// the loop function runs over and over again until power down or reset
void loop() {
	fps_start = millis();

	for (uint8_t row = 0; row < PANEL_SCAN_N; row++)
	{
		// Row select
		digitalWrite(PIN_LINE_A, !!(row & B00000001));
		digitalWrite(PIN_LINE_B, !!(row & B00000010));

		for (uint8_t block = 0; block < PANEL_SCAN_N; block++)	// 3 blocks
		{
			for (uint8_t rowInBlock = 0; rowInBlock < (PANEL_SIZE_Y / PANEL_SCAN_N); rowInBlock++)
			{
				for (uint8_t colInBlock = 0; colInBlock < (PANEL_SIZE_X / PANEL_SCAN_N); colInBlock++)	// 8 byte/pixel per chip
				{
					int pos = (rowInBlock + 1) * PANEL_SIZE_X * PANEL_SCAN_N - row * PANEL_SIZE_X - PANEL_SIZE_X / PANEL_SCAN_N * block - colInBlock - 1;
					
					digitalWrite(PIN_RED, !!(frame_buffer[pos] & 0xf800));
					digitalWrite(PIN_GREEN, !!(frame_buffer[pos] & 0x07e0));
					digitalWrite(PIN_BLUE, !!(frame_buffer[pos] & 0x001f));

					digitalWrite(PIN_CLK, HIGH);
					digitalWrite(PIN_CLK, LOW);
				}
			}
		}

		// update frame
		digitalWrite(PIN_LATCH, HIGH);
		digitalWrite(PIN_LATCH, LOW);

		digitalWrite(PIN_OE, LOW);
		delayMicroseconds(100);
		digitalWrite(PIN_OE, HIGH);
	}



	fps_stop = millis();
	fps_count++;

	if (millis() > fps_delay) {
		Serial.print(fps_count);
		Serial.print(" FPS, ");
		Serial.print(((fps_stop - fps_start) + fps_last) / 2);
		Serial.print(" ms. Uptime: ");
		Serial.print(millis() / 1000);
		Serial.print(" sec\n");

		fps_count = 0;
		fps_delay = millis() + 1000 - (millis() % 1000);	// Better delay. ~1 second.
	}

}
